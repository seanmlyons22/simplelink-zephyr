/*
 * Copyright (c) 2026 Texas Instruments Incorporated
 * SPDX-License-Identifier: Apache-2.0
 *
 * lp_em_cc2745r10_q1 (CC27xx): free uart0 (console/shell -> SEGGER RTT, see the
 * injected rtt.conf) and make it the DUT. uart0 already has pins + DMA
 * (dmas = <&dma 2 6>, <&dma 3 7>) from the SoC dts, same as CC23x0.
 *
 * Loopback: external jumper DIO1 (uart0 TXD) -> DIO2 (uart0 RXD).
 */

/ {
	chosen {
		/delete-property/ zephyr,console;
		/delete-property/ zephyr,shell-uart;
	};
};

dut: &uart0 {
	status = "okay";
	current-speed = <115200>;
};
