/*
 * Copyright (c) 2026 Texas Instruments Incorporated
 * SPDX-License-Identifier: Apache-2.0
 *
 * lp_em_cc2340r5 has a single UART (uart0), normally used as the console.
 * To test the UART itself we free it: the console moves to SEGGER RTT
 * (see lp_em_cc2340r5.conf) and uart0 becomes the DUT.
 *
 * Loopback: external jumper DIO20 (uart0 TXD) -> DIO22 (uart0 RXD).
 * uart0 already has pins + DMA (dmas = <&dma 2 6>, <&dma 3 7>) from the SoC/board dts.
 */

/ {
	chosen {
		/delete-property/ zephyr,console;
		/delete-property/ zephyr,shell-uart;
	};
};

dut: &uart0 {
	status = "okay";
	current-speed = <115200>;
};
