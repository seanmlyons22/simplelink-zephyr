## tests/drivers/adc/adc_lpf3_dma/testcase.yaml
```yaml
# Copyright (c) 2026 Texas Instruments Incorporated
# SPDX-License-Identifier: Apache-2.0

tests:
  drivers.adc.adc_lpf3_dma:
    tags:
      - drivers
      - adc
      - dma
    platform_allow:
      - lp_em_cc2340r5
      - lp_em_cc2745r10_q1/cc2745r10_q1
```

## tests/drivers/counter/counter_cc23x0_alarm/testcase.yaml
```yaml
tests:
  drivers.counter.cc23x0_alarm:
    tags:
      - drivers
      - counter
    platform_allow:
      - lp_em_cc2340r5
      - lp_em_cc2340r53
      - lp_em_cc2340r53_wcsp
      - lp_em_cc2340r5moda
```

## tests/drivers/counter/counter_lpf3/testcase.yaml
```yaml
tests:
  drivers.counter.lpf3:
    tags:
      - drivers
      - counter
    depends_on: counter
    harness: ztest
    platform_allow:
      - lp_em_cc2340r5
      - lp_em_cc2745r10_q1/cc2745r10_q1
```

## tests/drivers/crypto/cc23xx_cc27xx_aes/testcase.yaml
```yaml
common:
  tags:
    - drivers
    - crypto
  platform_allow:
    - lp_em_cc2340r5
    - lp_em_cc2745r10_q1/cc2745r10_q1
tests:
  drivers.crypto.cc23xx_cc27xx_aes.pio:
    extra_configs:
      - CONFIG_CRYPTO_CC23XX_CC27XX_DMA=n
  drivers.crypto.cc23xx_cc27xx_aes.dma:
    extra_configs:
      - CONFIG_CRYPTO_CC23XX_CC27XX_DMA=y
```

## tests/drivers/entropy/lpf3_rng_init/testcase.yaml
```yaml
tests:
  drivers.entropy.lpf3_rng_init:
    platform_allow:
      - lp_em_cc2340r5
      - lp_em_cc2745r10_q1/cc2745r10_q1
    tags:
      - drivers
      - entropy
```

## tests/drivers/gpio/gpio_lpf3_ioc/testcase.yaml
```yaml
common:
  tags:
    - drivers
    - gpio
  depends_on: gpio
  harness: ztest
  harness_config:
    fixture: gpio_loopback

tests:
  drivers.gpio.lpf3_ioc:
    platform_allow:
      - lp_em_cc2340r5
      - lp_em_cc2745r10_q1/cc2745r10_q1
```

## tests/drivers/timer/lpf3_tick_timing/testcase.yaml
```yaml
# Copyright (c) 2026 Texas Instruments Incorporated
# SPDX-License-Identifier: Apache-2.0

tests:
  drivers.timer.lpf3_tick_timing:
    tags:
      - drivers
      - timer
    platform_allow:
      - lp_em_cc2340r5
      - lp_em_cc2745r10_q1/cc2745r10_q1
```

## tests/drivers/uart/uart_config_lpf3/testcase.yaml
```yaml
common:
  tags:
    - drivers
    - uart
  depends_on: gpio
  harness: ztest
  harness_config:
    fixture: gpio_loopback
tests:
  drivers.uart.config_lpf3:
    platform_allow:
      - lp_em_cc2340r5
```

## tests/drivers/uart/uart_int_loopback/testcase.yaml
```yaml
common:
  tags:
    - drivers
    - uart
  depends_on: gpio
  harness: ztest
  harness_config:
    fixture: gpio_loopback
tests:
  drivers.uart.int_loopback:
    platform_allow:
      - lp_em_cc2340r5
      - lp_em_cc2745r10_q1/cc2745r10_q1
```

## tests/drivers/uart/uart_pm_lpf3/testcase.yaml
```yaml
common:
  tags:
    - drivers
    - uart
    - pm
  depends_on: gpio
  harness: ztest
  harness_config:
    fixture: gpio_loopback
tests:
  drivers.uart.pm_lpf3:
    platform_allow:
      - lp_em_cc2340r5
      - lp_em_cc2745r10_q1/cc2745r10_q1
```

## tests/drivers/watchdog/wdt_lpf3_long_timeout/testcase.yaml
```yaml
# Copyright (c) 2026 Texas Instruments Incorporated
# SPDX-License-Identifier: Apache-2.0

tests:
  drivers.watchdog.wdt_lpf3_long_timeout:
    tags:
      - drivers
      - watchdog
    platform_allow:
      - lp_em_cc2340r5
      - lp_em_cc2745r10_q1/cc2745r10_q1
```

## tests/soc/ti/simplelink/pm_standby/testcase.yaml
```yaml
tests:
  pm.soc.lpf3.standby:
    tags: pm
    platform_allow:
      - lp_em_cc2340r5
      - lp_em_cc2340r53
      - lp_em_cc2340r53_wcsp
      - lp_em_cc2340r5moda
      - lp_em_cc2745r10_q1/cc2745r10_q1
      - lp_em_cc2745r10_q1/cc2755r10
      - lp_em_cc2755p10
```

## tests/subsys/pm/device_runtime_api/testcase.yaml
```yaml
common:
  tags: pm

tests:
  pm.device_runtime.api:
    platform_allow:
    - native_sim
    - lp_em_cc2340r5
    - lp_em_cc2745r10_q1/cc2745r10_q1
  pm.device_runtime.isr_safe.api:
    platform_allow:
    - native_sim
    - lp_em_cc2340r5
    - lp_em_cc2745r10_q1/cc2745r10_q1
    extra_configs:
    - CONFIG_TEST_PM_DEVICE_ISR_SAFE=y
```
